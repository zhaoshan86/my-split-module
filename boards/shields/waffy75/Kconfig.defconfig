## boards/shields/waffy75/Kconfig.defconfig
```kconfig
if SHIELD_WAFFY75_LEFT

# Name must be less than 16 characters long!
config ZMK_KEYBOARD_NAME
    default "Waffy 75"

config ZMK_SPLIT_ROLE_CENTRAL
    default y

config ZMK_USB
    default y

config ZMK_SPLIT_BLE_CENTRAL_BATTERY_LEVEL_PROXY
    default y

config ZMK_SPLIT_BLE_CENTRAL_BATTERY_LEVEL_FETCHING
    default y
    
endif

if SHIELD_WAFFY75_LEFT || SHIELD_WAFFY75_RIGHT

config ZMK_SPLIT
    default y
    
config ZMK_STUDIO
    default y

endif
```

## boards/shields/waffy75/Kconfig.shield
```kconfig
# Copyright (c) 2020 The ZMK Contributors
# SPDX-License-Identifier: MIT
# No whitespace after the comma or in your part name!
config SHIELD_WAFFY75_LEFT
    def_bool $(shields_list_contains,waffy75_left)

config SHIELD_WAFFY75_RIGHT
    def_bool $(shields_list_contains,waffy75_right)
    
```
