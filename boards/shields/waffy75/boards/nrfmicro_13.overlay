/* Change pins define to fit EWT73 */

&pro_micro: connector {
    gpio-map
        = <0 0 &gpio0 26 0>      /* D0 */ /* <0 0 &gpio0 8 0> */
        , <1 0 &gpio0 22 0>      /* D1 */ /* <1 0 &gpio0 6 0> */
        , <2 0 &gpio1 0 0>     /* D2 */ /* <2 0 &gpio0 15 0> */
        , <3 0 &gpio1 2 0>     /* D3 */ /* <3 0 &gpio0 17 0> */
        , <4 0 &gpio1 4 0>     /* D4/A6 */ /* <4 0 &gpio0 20 0> */
        , <5 0 &gpio0 13 0>     /* D5 */ 
        , <6 0 &gpio0 24 0>     /* D6/A7 */
        , <7 0 &gpio0 9 0>      /* D7 */
        , <8 0 &gpio1 10 0>     /* D8/A8 */ /* <8 0 &gpio0 10 0> */
        , <9 0 &gpio1 6 0>      /* D9/A9 */
        , <10 0 &gpio1 11 0>    /* D10/A10 */
        , <16 0 &gpio0 28 0>    /* D16 */
        , <14 0 &gpio0 3 0> /* D14 */
        , <15 0 &gpio1 13 0>    /* D15 */
        , <18 0 &gpio0 2 0> /* D18/A0 */
        , <19 0 &gpio0 29 0>    /* D19/A1 */
        , <20 0 &gpio0 31 0>    /* D20/A2 */
        , <21 0 &gpio0 30 0>    /* D21/A3 */
        ;
};
